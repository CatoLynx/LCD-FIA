#include <TimerOne.h>

#define PIN_STR 2
#define PIN_FR  3
#define PIN_DI  4
#define PIN_CLK 5

#define MUX4 (0b10)       // Control bits for 1:4 multiplex mode
#define RAM1 (0)          // Control bit for writing to RAM1
#define RAM2 (1 << 2)     // Control bit for writing to RAM2
#define COM0 (0)          // Control address for common 0
#define COM1 (0b100 << 3) // Control address for common 1
#define COM2 (0b010 << 3) // Control address for common 2
#define COM3 (0b110 << 3) // Control address for common 3
#define SET (1 << 6)      // Control bit for setting all pixels
#define BLANK (1 << 7)    // Control bit for blanking all pixels

byte bitmap1 [] = {
  0xFF, 0xFF, 0xFF, 0xFF, 0xFF, 0xFF, 0xFF, 0xFF, 0xFF, 0xFF, 0xFF, 0xFF, 0xFF, 0xFF, 0xFF, 0xFF,
0xFF, 0xFF, 0xFF, 0xFF, 0xFF, 0xFF, 0xFF, 0xFF, 0xFF, 0xFF, 0xFF, 0xFF, 0xFF, 0xFF, 0xFF, 0xFF,
0xFF, 0xFF, 0xFF, 0xFF, 0xFF, 0xFF, 0xFF, 0xFF, 0xFF, 0xFF, 0xFF, 0xFF, 0xFF, 0xFF, 0xFF, 0xFF,
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0xFF, 0xFF, 0xFF, 0xFF, 0xFF, 0xFF, 0xFF, 0xFF, 0xFF, 0xFF, 0xFF, 0xFF, 0xFF, 0xFF, 0xFF, 0xFF,

};

byte bitmap2 [] = {
 0x00, 0x00, 0x00, 0x00, 0x00, 0x00, 0x00, 0x00, 0x00, 0x00, 0x00, 0x00, 0x00, 0x00, 0x00, 0x00,
0x00, 0x00, 0x00, 0x00, 0x00, 0x00, 0x00, 0x00, 0x00, 0x00, 0x00, 0x00, 0x00, 0x00, 0x00, 0x00,
0x00, 0x00, 0x00, 0x00, 0x00, 0x00, 0x00, 0x00, 0x00, 0x00, 0x00, 0x00, 0x00, 0x00, 0x00, 0x00,
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0x00, 0x00, 0x00, 0x00, 0x00, 0x00, 0x00, 0x00, 0x00, 0x00, 0x00, 0x00, 0x00, 0x00, 0x00, 0x00,


};


const byte BACKPLANES[4] = {COM2, COM1, COM3, COM0};

byte getEndian(byte backplane) {
  if (backplane == COM0 || backplane == COM1) {
    return MSBFIRST;
  } else {
    return LSBFIRST;
  }
}

byte getBitmapByte(byte data[], byte col, byte backplane) {
  byte offset;
  switch (backplane) {
    case COM0: {
        offset = 3;
        break;
      }
    case COM1: {
        offset = 1;
        break;
      }
    case COM2: {
        offset = 0;
        break;
      }
    case COM3: {
        offset = 2;
        break;
      }
  }
  return data[col * 4 + offset];
}

void shiftBits(byte value, unsigned int count) {
  for (byte i = 0; i < count; i++) {
    digitalWrite(PIN_DI, value);
    digitalWrite(PIN_CLK, 1);
    digitalWrite(PIN_CLK, 0);
  }
}

void frameSync() {
  digitalWrite(PIN_FR, !digitalRead(PIN_FR));
}

void transmitPanel(byte data1[], byte data2[], byte ramSel) {
  // data: Bitmap data in column-major format (384 bytes, corresponding to 96 x 32 / 8)
  // ramSel: which RAM to write to (RAM1 or RAM2)

  int col;
  byte bpl;
  byte ctrl;
  byte numDataBytes;
  bool bitStuffing;
  for (byte bplIdx = 0; bplIdx < 4; bplIdx++) {
    bpl = BACKPLANES[bplIdx];
    col = 0;
    while (col <= 95) {
      if (col == 10 || col == 34 || col == 58 || col == 82) {
        numDataBytes = 4;
        bitStuffing = true;
        shiftBits(0, 4);
      } else {
        numDataBytes = 5;
        bitStuffing = false;
      }

      for (byte i = 0; i < numDataBytes; i++) {
        shiftOut(PIN_DI, PIN_CLK, getEndian(bpl), getBitmapByte(data1, col, bpl));
        col++;
      }

      if (bitStuffing) {
        shiftBits(0, 4);
      }

      ctrl = MUX4 | ramSel | bpl;
      shiftOut(PIN_DI, PIN_CLK, MSBFIRST, ctrl);
    }

    col = 0;
    while (col <= 95) {
      if (col == 10 || col == 34 || col == 58 || col == 82) {
        numDataBytes = 4;
        bitStuffing = true;
        shiftBits(0, 4);
      } else {
        numDataBytes = 5;
        bitStuffing = false;
      }

      for (byte i = 0; i < numDataBytes; i++) {
        shiftOut(PIN_DI, PIN_CLK, getEndian(bpl), getBitmapByte(data2, col, bpl));
        col++;
      }

      if (bitStuffing) {
        shiftBits(0, 4);
      }

      ctrl = MUX4 | ramSel | bpl;
      shiftOut(PIN_DI, PIN_CLK, MSBFIRST, ctrl);
    }

    digitalWrite(PIN_STR, 1);
    digitalWrite(PIN_STR, 0);
  }
}

void setup() {
  pinMode(PIN_STR, OUTPUT);
  pinMode(PIN_FR, OUTPUT);
  pinMode(PIN_DI, OUTPUT);
  pinMode(PIN_CLK, OUTPUT);

  Timer1.initialize(2500); // total 5 ms = 200 Hz
  Timer1.attachInterrupt(frameSync);
}

void loop() {
  transmitPanel(bitmap2, bitmap1, RAM1);
  delay(2000);
  transmitPanel(bitmap1, bitmap2, RAM2);
  delay(2000);
}
